## drivers/media/platform/soph/sensor/Kconfig
```kconfig
# SPDX-License-Identifier: GPL-2.0-only
config VIDEO_SOPHGO_SENSOR
	bool "Sophgo Sensor Devices"
	help
	  If you have sensor device designed by Sophgo, say Y.

	  Note that this option doesn't include new drivers in the kernel:
	  saying N will just cause Kconfig to skip all the questions about
	  Sophgo sensor devices.

config SENSOR_V4L2_IMX585
	depends on I2C && VIDEO_DEV
	tristate "imx585 support"
	default n
	help
	  Support for Sensor on the CV186X SoC.

config SENSOR_V4L2_IMX307
	depends on I2C && VIDEO_DEV
	tristate "imx307 support"
	default n
	help
	  Support for Sensor on the CV186X SoC.

config SENSOR_V4L2_IMX327
	depends on I2C && VIDEO_DEV
	tristate "imx327 support"
	default n
	help
	  Support for Sensor on the CV186X SoC.

config SENSOR_V4L2_IMX412
	depends on I2C && VIDEO_DEV
	tristate "imx412 support"
	default n
	help
	  Support for Sensor on the CV186X SoC.

config SENSOR_V4L2_IMX415
	depends on I2C && VIDEO_DEV
	tristate "imx415 support"
	default n
	help
	  Support for Sensor on the CV186X SoC.

config SENSOR_V4L2_IMX900
	depends on I2C && VIDEO_DEV
	tristate "imx900 support"
	default n
	help
	  Support for Sensor on the CV186X SoC.

config SENSOR_V4L2_LT6911
	depends on I2C && VIDEO_DEV
	tristate "lt6911 support"
	default n
	help
	  Support for Sensor on the CV186X SoC.

config SENSOR_V4L2_OS04A10
	depends on I2C && VIDEO_DEV
	tristate "os04a10 support"
	default n
	help
	  Support for Sensor on the CV186X SoC.

config SENSOR_V4L2_OS04E10
	depends on I2C && VIDEO_DEV
	tristate "os04e10 support"
	default n
	help
	  Support for Sensor on the CV186X SoC.

config SENSOR_V4L2_OS08B10
	depends on I2C && VIDEO_DEV
	tristate "os08b10 support"
	default n
	help
	  Support for Sensor on the Athena2 SoC.

config SENSOR_V4L2_GC4653
	depends on I2C && VIDEO_DEV
	tristate "gc4653 support"
	default n
	help
	  Support for Sensor on the CV186X SoC.

config SENSOR_V4L2_GC8613
	depends on I2C && VIDEO_DEV
	tristate "gc8613 support"
	default n
	help
	  Support for Sensor on the CV186X SoC.

config SENSOR_V4L2_PR2100
	depends on I2C && VIDEO_DEV
	tristate "pr2100 support"
	default n
	help
	  Support for Sensor on the CV186X SoC.

config SENSOR_V4L2_PR2020
	depends on I2C && VIDEO_DEV
	tristate "pr2020 support"
	default n
	help
	  Support for Sensor on the CV186X SoC.

config SENSOR_V4L2_AR2020
	depends on I2C && VIDEO_DEV
	tristate "ar2020 support"
	default n
	help
	  Support for Sensor on the CV186X SoC.

config SENSOR_V4L2_NC021
	depends on I2C && VIDEO_DEV
	tristate "nc021 support"
	default n
	help
	  Support for Sensor on the CV186X SoC.

config SENSOR_V4L2_SC020HGS
	depends on I2C && VIDEO_DEV
	tristate "sc020hgs support"
	default n
	help
	  Support for Sensor on the CV186X SoC.

config SENSOR_V4L2_SC233HGS
	depends on I2C && VIDEO_DEV
	tristate "sc233hgs support"
	default n
	help
	  Support for Sensor on the CV186X SoC.

config SENSOR_V4L2_SC500AI
	depends on I2C && VIDEO_DEV
	tristate "sc500ai support"
	default n
	help
	  Support for Sensor on the CV186X SoC.


config SENSOR_V4L2_SC831HAI
	depends on I2C && VIDEO_DEV
	tristate "sc831hai support"
	default n
	help
	  Support for Sensor on the CV186X SoC.
```

## drivers/net/can/cvitek/Kconfig
```kconfig
# SDVT-License-Identifier: GPL-2.0-only

config CAN_SDVT
	tristate "soph_can/SDVT_CAN in Generic Platform Bus"
	help
	  This driver adds SDVT IP by CONFIG_CAN_SDVT_CAN
```

## drivers/soc/cvitek/Kconfig.cpu
```kconfig
menu "CVITEK CPU selection"
        depends on ARCH_CVITEK
choice
        prompt "Select CVITEK CPU"
        default CHIP_CPU_CV186X

config CHIP_CPU_CV84X2
        bool "CV84X2"

config CHIP_CPU_CV186X
        bool "CV186X"

config CHIP_CPU_C906B
        bool "C906B"

config CHIP_CPU_C906L
        bool "C906L"

endchoice

endmenu
```
